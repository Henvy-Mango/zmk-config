## boards/ggbr/Kconfig.ggbr
```kconfig
# Copyright (c) 2025 Naomi
# SPDX-License-Identifier: Apache-2.0

config BOARD_GGBR
	select SOC_NRF52840_QIAA
    imply RETAINED_MEM
    imply RETENTION
    imply RETENTION_BOOT_MODE
```

## boards/ggbr/board.yml
```yaml
board:
  name: ggbr
  vendor: naomi233
  socs:
    - name: nrf52840
  revision:
    format: major.minor.patch
    default: 1.0.0
    revisions:
      - name: 1.0.0
      - name: 1.2.0
```
