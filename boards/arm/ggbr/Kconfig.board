## boards/arm/ggbr/Kconfig.board
```kconfig
# Copyright (c) 2025 Naomi
# SPDX-License-Identifier: MIT

config BOARD_GGBR
    bool "ggbr"
    depends on SOC_NRF52840_QIAA
```

## boards/arm/ggbr/Kconfig.defconfig
```kconfig
# Copyright (c) 2025 Naomi
# SPDX-License-Identifier: MIT

if BOARD_GGBR

config ZMK_KEYBOARD_NAME
    default "ggbr"

if USB_DEVICE_STACK

config USB_NRFX
    default y

endif # USB_DEVICE_STACK

config BT_CTLR
    default BT

endif # BOARD_GGBR
```

## boards/shields/arm/ggbr/Kconfig.defconfig
```kconfig
# Copyright (c) 2021 The ZMK Contributors
# SPDX-License-Identifier: MIT

if BOARD_GGBR

config BOARD
    default "ggbr"

if USB_DEVICE_STACK

config USB_NRFX
    default y

endif # USB_DEVICE_STACK

config BT_CTLR
    default BT

endif # BOARD_GGBR
```

## boards/shields/ggbr/Kconfig.defconfig
```kconfig
# Copyright (c) 2025 Naomi
# SPDX-License-Identifier: MIT

if SHIELD_GGBR

config ZMK_KEYBOARD_NAME
    default "ggbr"

endif
```

## boards/shields/ggbr/Kconfig.shield
```kconfig
# Copyright (c) 2025 Naomi
# SPDX-License-Identifier: MIT

config SHIELD_GGBR
    def_bool $(shields_list_contains,ggbr)
```
